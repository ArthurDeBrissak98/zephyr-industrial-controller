## tests/input_fault/testcase.yaml
```yaml
tests:
  controller.input_fault:
    platform_allow:
      - qemu_cortex_m3
      - qemu_cortex_m3/ti_lm3s6965
      - native_sim/native/64
    tags: protection
```

## tests/io_hw/testcase.yaml
```yaml
tests:
  controller.hw_io:
    platform_allow: qemu_cortex_m3
    tags: [controller, adc]
```

## tests/modbus/testcase.yaml
```yaml
tests:
  controller.modbus_map:
    platform_allow: qemu_cortex_m3
    tags: [controller, modbus]
```

## tests/motor/testcase.yaml
```yaml
tests:
  controller.motor_protections:
    platform_allow: qemu_cortex_m3
    tags: [controller, motor, protection]
```

## tests/motor_settings/Kconfig
```kconfig
mainmenu "Motor settings tests"
source "Kconfig.zephyr"
config APP_SETTINGS
    bool
    default y
```

## tests/motor_settings/testcase.yaml
```yaml
tests:
  controller.motor_settings:
    platform_allow: qemu_cortex_m3
    tags: [controller, settings, motor]
```

## tests/scenario/testcase.yaml
```yaml
tests:
  controller.scenario:
    platform_allow:
      - qemu_cortex_m3
      - qemu_cortex_m3/ti_lm3s6965
      - native_sim/native/64
    tags: controller
    timeout: 30
```

## tests/test_pid/testcase.yaml
```yaml
tests:
  apps.system_monitor.test_pid:
    platform_allow:
      - native_sim
      - native_sim/native/64
    tags: pid
```

## tests/test_sensor/testcase.yaml
```yaml
tests:
  apps.system_monitor.test_sensor:
    platform_allow:
      - native_sim
      - native_sim/native/64
    tags: sensor
```
